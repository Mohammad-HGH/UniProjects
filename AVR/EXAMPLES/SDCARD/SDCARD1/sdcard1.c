/******************************************************************************
MMC/SD/SD HC card driver example for the CodeVisionAVR V2.04.4+ compiler
(C) 2009-2011 HP InfoTech s.r.l., Pavel Haiduc

The example is intended to be run on the Mega128-Dev development board
from www.priio.com.
The development board uses an ATmega128 chip running at 14.745600 MHz

The SD card socket on the development board is connected to the
following I/O ports:

SD socket    CD4050    ATmega128
pin1  /CS -----<|----- PORTD bit6
pin2  SI  -----<|----- MOSI
pin3  GND
pin4  +3.3V
pin5  SCK -----<|----- SCK
pin6  GND
pin7  SO  ------------ MISO
pin9  GND
pin10 /CD ------------ PORTG bit4 with 10k pull-up resistor to +5V
pin11 WP  ------------ PORTG bit3 with 10k pull-up resistor to +5V
pin12 GND

The CD4050 CMOS buffer is powered from a +3.3V supply and
performs logic level translation from 5V (AVR) to 3.3V (SD card).

For other I/O port connections, you need to make appropriate changes in the
"Project|Configure|C Compiler|Libraries|MMC/SD/SD HC Card and FAT Support"
menu.

The development board's serial socket P9 must be connected to the PC COM port.
The CodeVisionAVR Terminal is used for displaying data received from the
development board.
The Terminal must be configured for:
Baud Rate: 19200
Data Bits: 8
Parity: None
Stop Bits: 1
Emulation: TTY
Handshaking: None
Append LF on Reception: OFF
******************************************************************************/

/* ATmega128 I/O register definitions */
#include <mega128.h>
/* MMC/SD/SD HC card support */
#include <sdcard.h>
/* printf */
#include <stdio.h>

/* Timer1 overflow interrupt frequency [Hz] */
#define T1_OVF_FREQ 100
/* Timer1 clock prescaler value */
#define T1_PRESC 1024L
/* Timer1 initialization value after overflow */
#define T1_INIT (0x10000L-(_MCU_CLOCK_FREQUENCY_/(T1_PRESC*T1_OVF_FREQ)))

/* USART Baud rate */
#define BAUD_RATE 19200
#define BAUD_INIT (_MCU_CLOCK_FREQUENCY_/(BAUD_RATE*16L)-1)

/* 100Hz timer interrupt generated by ATmega128 Timer1 overflow */
interrupt [TIM1_OVF] void timer_comp_isr(void)
{
/* re-initialize Timer1 */
TCNT1H=T1_INIT>>8;
TCNT1L=T1_INIT&0xFF;
/* card access low level timing function */
disk_timerproc();
}

void main(void)
{
unsigned char disk_status;
unsigned int sector_size;
unsigned long int sector_count;

/* initialize Timer1 overflow interrupts in Mode 0 (Normal) */
TCCR1A=0x00;
/* clkio/1024 */
TCCR1B=(1<<CS12)|(1<<CS10);
/* timer overflow interrupts will occur with 100Hz frequency */
TCNT1H=T1_INIT>>8;
TCNT1L=T1_INIT&0xFF;
/* enable Timer1 overflow interrupt */
TIMSK=1<<TOIE1;

/* initialize the USART0 TX, 8N1, Baud rate: 19200 */
UCSR0A=0;
UCSR0B=1<<TXEN0;
UCSR0C=(1<<UCSZ01)|(1<<UCSZ00);
UBRR0H=BAUD_INIT>>8;
UBRR0L=BAUD_INIT&0xFF;

/* globally enable interrupts */
#asm("sei")

printf("SD card driver test\r\nInitializing drive ...\r\n");
/* initialize SPI interface and card driver */
disk_status=disk_initialize(0);
/* display disk initialization result */
if (disk_status & STA_NODISK) printf("Card not present\r\n");
else
if (disk_status & STA_NOINIT) printf("Disk init failed\r\n");
else
if (disk_status & STA_PROTECT) printf("Card write protected\r\n");
/* all status flags are 0, disk initialization OK */
else
    {
    printf("Init OK\r\n");
    /* get the sector size */
    if (disk_ioctl(0,GET_SECTOR_SIZE,&sector_size)==RES_OK)
       {
       /* sector size read OK, display it */
       printf("Sector size=%u\r\n",sector_size);
       /* get the sector count */
       if (disk_ioctl(0,GET_SECTOR_COUNT,&sector_count)==RES_OK)
          /* sector count read OK, display it */
          printf("Sector count=%lu\r\n",sector_count);
       else
          printf("Error reading\nsector count\r\n");
       }
    else printf("Error reading sector size\r\n");
    }
/* stop here */
while(1);
}
